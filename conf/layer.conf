## conf/layer.conf
```bitbake
BBPATH .= ":${LAYERDIR}"
BBFILES += "${LAYERDIR}/recipes/*/*.bb \
            ${LAYERDIR}/recipes/*/*.bbappend \
"

BBFILE_COLLECTIONS += "adit-weston"
BBFILE_PRIORITY_adit-weston = "200"
BBFILE_PATTERN_adit-weston = "^${LAYERDIR}/"

#TCMODE = "external-sourcery"
```
